## Kconfig
```kconfig
config THEME_COLOR_1
    string "Color 1"
    default "4aedff"

config THEME_COLOR_2
    string "Color 2"
    default "ff8acd"

config THEME_COLOR_3
    string "Color 3"
    default "b03e80"
    
config THEME_COLOR_4
    string "Color 4"
    default "ffffff"
    
config THEME_COLOR_5
    string "Color 5"
    default "000000"

config THEME_COLOR_6
    string "Color 6"
    default "dddddd"

config SNAKE_FATNESS
    int "Snake fatness"
    default 2

config SPLASH_USE_SNAKE_2
    bool "Use Snake 2 Splash screen"
    default n

config USE_BUZZER
    bool "Use buzzer"
    default y

config SNAKE_BOARD_SIZE
    string "Snake board size"
    default "XXL"

config SNAKE_WALK_INTERVAL
    int "Snake walk interval"
    default 10

config LOGO_WALK_INTERVAL
    int "Logo walk interval"
    default 50

config CHECKERED_BOARD
    bool "Checkered board"
    default y

config WPM_SLOW
    int "WPM slow"
    default 20

config WPM_MEDIUM
    int "WPM medium"
    default 40

config WPM_FAST
    int "WPM fast"
    default 80

config WPM_SUPER_FAST
    int "WPM super fast"
    default 90
```
